## config/boards/shields/taira/Kconfig.defconfig
```kconfig
# Copyright (c) 2020 The ZMK Contributors
# SPDX-License-Identifier: MIT

if SHIELD_TAIRA_LEFT

config ZMK_KEYBOARD_NAME
	default "Taira"

config ZMK_SPLIT_BLE_ROLE_CENTRAL
	default y

endif

if SHIELD_TAIRA_LEFT || SHIELD_TAIRA_RIGHT

config ZMK_SPLIT
    default y

config ZMK_SLEEP
    default y
    
config ZMK_IDLE_SLEEP_TIMEOUT
    default 1800000
    
config ZMK_EXT_POWER
    default y

config ZMK_BATTERY_REPORTING
    default y

config ZMK_BATTERY_REPORT_INTERVAL
    default 60

#config ZMK_SPLIT_BLE_CENTRAL_BATTERY_LEVEL_PROXY
#    default y
#
#config ZMK_SPLIT_BLE_CENTRAL_BATTERY_LEVEL_FETCHING
#    default y

config ZMK_POINTING
    default y

if ZMK_BACKLIGHT

config PWM
    default y

config LED_PWM
    default y

endif # ZMK_BACKLIGHT

if ZMK_DISPLAY

config I2C
    default y

config SSD1306
    default y
    
endif # ZMK_DISPLAY

if LVGL

config LV_Z_VDB_SIZE
    default 64

config LV_DPI_DEF
    default 148

config LV_Z_BITS_PER_PIXEL
    default 1

choice LV_COLOR_DEPTH
    default LV_COLOR_DEPTH_1
endchoice

endif # LVGL

endif
```

## config/west.yml
```yaml
manifest:
  remotes:
    - name: zmkfirmware
      url-base: https://github.com/zmkfirmware
    # support nice_oled and nice_epaper
    - name: loss-and-quick
      url-base: https://github.com/loss-and-quick
  projects:
    - name: zmk
      remote: zmkfirmware
      revision: main
      import: app/west.yml
    # support nice_oled and nice_epaper
    - name: zmk-nice-oled
      remote: loss-and-quick
      revision: main
  self:
    path: config
```
